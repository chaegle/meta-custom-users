## conf/layer.conf
```bitbake
# We have a conf and classes directory, add to BBPATH
BBPATH .= ":${LAYERDIR}"

# We have recipes-* directories, add to BBFILES
BBFILES += "${LAYERDIR}/recipes-*/*/*.bb \
	${LAYERDIR}/recipes-*/*/*.bbappend"

BBFILE_COLLECTIONS += "custom-users"
BBFILE_PATTERN_custom-users = "^${LAYERDIR}/"
BBFILE_PRIORITY_custom-users = "6"

LAYERSERIES_COMPAT_custom-users = "daisy jethro morty rocko thud zeus gatesgarth"
```
